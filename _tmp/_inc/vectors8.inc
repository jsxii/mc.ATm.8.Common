;------------------------------------------------------------
;-- Vectors --
;------------------------------------------------------------
vRESET:		RJMP		Init
vINT0:		RJMP		iINT0
vINT1:		RJMP		iINT1
vT2comp:	RJMP		iT2comp
vT2ovf:		RJMP		iT2ovf
vT1capt:	RJMP		iT1capt
vT1compA:	RJMP		iT1compA
vT1compB:	RJMP		iT1compB
vT1ovf:		RJMP		iT1ovf
vT0ovf:		RJMP		iT0ovf
vSPIstc:	RJMP		iSPIstc
vUSARTrxc:	RJMP		iUSARTrxc
vUSARTudre:	RJMP		iUSARTudre
vUSARTtxc:	RJMP		iUSARTtxc
vADCcompl:	RJMP		iADCcompl
vEErdy:		RJMP		iEErdy
vAcomp:		RJMP		iAcomp
vTWI:		RJMP		iTWI
vSPMrdy:	RJMP		iSPMrdy
;------------------------------------------------------------
