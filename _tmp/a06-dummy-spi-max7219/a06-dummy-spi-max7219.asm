.include	"m8def.inc"

.MACRO	SEND
	LDI	R16,0x00
	OUT	PORTB,R16

	NOP0-

	LDI	R17,@0
	RCALL	SendSPI

	LDI	R17,@1
	RCALL	SendSPI

	LDI	R17,@0
	RCALL	SendSPI

	LDI	R17,@1
	RCALL	SendSPI


	NOP

	LDI	R16,0x01
	OUT	PORTB,R16
	NOP
.ENDM

.CSEG
.ORG	0x0000

CLI

LDI	R16,low(RAMEND)
OUT	SPL,R16
LDI	R16,high(RAMEND)
OUT	SPH,R16

LDI	R16,0x2D
OUT	DDRB,R16

; |SPIE |SPE |DODR |m\s |CPOL |CPHA | SPR1 | SPR0 |
LDI	R16,0b01010001
OUT	SPCR,R16


SEND	0x0C,0x01
SEND	0x09,0x00
SEND	0x0A,0x08
SEND	0x0B,0x07
SEND	0x0F,0x00
NOP
NOP
NOP
NOP
SEND	0x01,0x00
SEND	0x02,0x18
SEND	0x03,0x3C
SEND	0x04,0x7E
SEND	0x05,0xFF
SEND	0x06,0x18
SEND	0x07,0x18
SEND	0x08,0x01
loop:
NOP
NOP
NOP
NOP
RJMP	loop

SendSPI:
OUT	SPDR,R17
wait:
SBIS	SPSR,SPIF
RJMP	wait
RET
